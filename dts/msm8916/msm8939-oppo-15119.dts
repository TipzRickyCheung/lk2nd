// SPDX-License-Identifier: GPL-2.0-only

/dts-v1/;

#include <skeleton.dtsi>

/ {
	compatible = "qcom,msm8939-mtp", "qcom,msm8939";
	qcom,msm-id = <239 0>;
	qcom,board-id = <8 0 15119>;

	/*
	 * Before building for R7s Plus, please comment out all dtbs except
	 * "$(LOCAL_DIR)/msm8939-oppo-15119.dtb" at './rules.mk'.
	 * r7splus doesn't work with multi-dtbs; only responds with "dtb not found".
	 */
	oppo-r7splus {
		model = "OPPO R7s Plus";
		compatible = "oppo,r7splus", "qcom,msm8939", "lk2nd,device";
	};
};
