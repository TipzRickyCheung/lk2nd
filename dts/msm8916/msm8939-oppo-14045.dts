// SPDX-License-Identifier: GPL-2.0-only

/dts-v1/;

#include <skeleton.dtsi>

/ {
	compatible = "qcom,msm8939-mtp", "qcom,msm8939";
	qcom,msm-id = <239 0>;
	qcom,board-id = <8 0 14045>;

	/*
	 * Before building for R1c, please comment out all dtbs except
	 * "$(LOCAL_DIR)/msm8939-oppo-14045.dtb" at './rules.mk'.
	 * r1c doesn't work with multi-dtbs; only responds with "dtb not found".
	 */
	oppo-r1c {
		model = "OPPO R1c";
		compatible = "oppo,r1c", "qcom,msm8939", "lk2nd,device";
	};
};
