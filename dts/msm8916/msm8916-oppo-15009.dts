// SPDX-License-Identifier: GPL-2.0-only

/dts-v1/;

#include <skeleton.dtsi>

/ {
	compatible = "msm8916-mtp", "qcom,msm8916";
	qcom,msm-id = <206 0>, <248 0>, <249 0>, <250 0>;
	qcom,board-id = <8 0 15009>;

	/*
	 * Before building for A51f, please comment out all dtbs except
	 * "$(LOCAL_DIR)/msm8916-oppo-15009.dtb" at './rules.mk'.
	 * a51f doesn't work with multi-dtbs; only responds with "dtb not found".
	 */
	oppo-a51f {
		model = "OPPO Mirror 5s";
		compatible = "oppo,a51f", "qcom,msm8916", "lk2nd,device";
	};
};
