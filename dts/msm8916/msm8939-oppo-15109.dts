// SPDX-License-Identifier: GPL-2.0-only

/dts-v1/;

#include <skeleton.dtsi>

/ {
	compatible = "qcom,msm8939-mtp", "qcom,msm8939";
	qcom,msm-id = <239 0>;
	qcom,board-id = <8 0 15109>;

	/*
	 * Before building for F1f, please comment out all dtbs except
	 * "$(LOCAL_DIR)/msm8939-oppo-15109.dtb" at './rules.mk'.
	 * f1f doesn't work with multi-dtbs; only responds with "dtb not found".
	 */
	oppo-f1f {
		model = "OPPO F1f";
		compatible = "oppo,f1f", "qcom,msm8939", "lk2nd,device";
	};
};
